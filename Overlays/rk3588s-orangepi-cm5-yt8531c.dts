/dts-v1/;

#include "rk3588s-orangepi-cm5.dts"

/ {
	model = "RK3588S OrangePi CM5 carrier with YT8531C GbE";
	compatible = "xunlong,orangepi-cm5", "rockchip,rk3588s";
};

&gmac1 {
	status = "okay";

	/*
	 * Board wiring from provided pin map:
	 *   GMAC1_MCLKINOUT <-> YT8531C CLKOUT
	 *   GMAC1_MDC/MDIO  <-> YT8531C MDC/MDIO
	 *   RGMII data bus  <-> YT8531C TXD/RXD
	 *   GPIO1_C1        <-> YT8531C RESET_N
	 *   GPIO1_C0        <-> YT8531C INT_N
	 */
	phy-mode = "rgmii-rxid";
	clock_in_out = "input";
	rx_delay = <0x0>;
	tx_delay = <0x42>;

	snps,reset-gpio = <&gpio1 RK_PC1 GPIO_ACTIVE_LOW>;
	snps,reset-active-low;
	snps,reset-delays-us = <0 20000 100000>;

	pinctrl-names = "default";
	pinctrl-0 = <&gmac1_miim
		     &gmac1_rx_bus2
		     &gmac1_tx_bus2
		     &gmac1_rgmii_clk
		     &gmac1_clkinout>;

	phy-handle = <&rgmii_phy1>;

	mdio1: mdio {
		#address-cells = <1>;
		#size-cells = <0>;

		rgmii_phy1: ethernet-phy@1 {
			reg = <1>;
			compatible = "ethernet-phy-ieee802.3-c22";
			interrupt-parent = <&gpio1>;
			interrupts = <RK_PC0 IRQ_TYPE_LEVEL_LOW>;
			reset-gpios = <&gpio1 RK_PC1 GPIO_ACTIVE_LOW>;
			reset-assert-us = <20000>;
			reset-deassert-us = <100000>;
		};
	};
};